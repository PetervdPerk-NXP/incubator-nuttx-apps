## canutils/libcanardv1/Kconfig
```kconfig
#
# For a description of the syntax of this configuration file,
# see the file kconfig-language.txt in the NuttX tools repository.
#

config CANUTILS_LIBCANARDV1
	bool "libcanard UAVCAN v1 Library"
	default n
	depends on NET_CAN
	---help---
		Enable the libcanard UAVCAN v1 library.

if CANUTILS_LIBCANARDV1

config LIBCANARDV1_URL
	string "libcanard URL"
	default "https://github.com/UAVCAN/libcanard/archive"
	---help---
		libcanard URL.

config LIBCANARDV1_VERSION
	string "libcanard Version"
	default "e776368355a890543035cdae356710ade5d7baea"
	---help---
		libcanard version.

endif
```

## examples/candump/Kconfig
```kconfig
#
# For a description of the syntax of this configuration file,
# see the file kconfig-language.txt in the NuttX tools repository.
#

config EXAMPLES_CANDUMP
	tristate "Example port of CAN-UTILS CANDUMP tool"
	default n
	depends on NET_CAN
	---help---
		Enable the CAN packet socket example

if EXAMPLES_CANDUMP
endif
```

## examples/canpkt/Kconfig
```kconfig
#
# For a description of the syntax of this configuration file,
# see the file kconfig-language.txt in the NuttX tools repository.
#

config EXAMPLES_CANPKT
	tristate "CAN packet socket example"
	default n
	depends on NET_CAN
	---help---
		Enable the CAN packet socket example

if EXAMPLES_CANPKT
endif
```

## examples/uavcan/Kconfig
```kconfig
#
# For a description of the syntax of this configuration file,
# see the file kconfig-language.txt in the NuttX tools repository.
#

config EXAMPLES_LIBUAVCAN_EXAMPLE
	tristate "Example port of uavcan"
	default n
	depends on NET_CAN
	---help---
		Port of libuavcan on top of NuttX SocketCAN

if EXAMPLES_LIBUAVCAN_EXAMPLE
endif
```
